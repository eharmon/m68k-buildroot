## apt/Config.in
```kconfig
source "$BR2_EXTERNAL_APT_PATH/package/apt/Config.in"
source "$BR2_EXTERNAL_APT_PATH/package/dpkg/Config.in"
source "$BR2_EXTERNAL_APT_PATH/package/triehash/Config.in"
```

## apt/package/apt/Config.in
```kconfig
config BR2_PACKAGE_APT
	bool "apt"

	depends on BR2_INSTALL_LIBSTDCPP
	select BR2_PACKAGE_BERKELEYDB
	select BR2_PACKAGE_BZIP2
	select BR2_PACKAGE_DPKG
	select BR2_PACKAGE_GNUPG
	select BR2_PACKAGE_GNUPG_GPGV
	select BR2_PACKAGE_GNUPG_RSA
	select BR2_PACKAGE_GNUTLS
	select BR2_PACKAGE_LIBGCRYPT
	select BR2_PACKAGE_TAR
	select BR2_PACKAGE_ZLIB
	select BR2_PACKAGE_XZ
	select BR2_PACKAGE_LZ4
	select BR2_PACKAGE_XXHASH
	help
		Manage packages with the Advanced Package Tool.
```

## apt/package/dpkg/Config.in
```kconfig
config BR2_PACKAGE_DPKG
	bool "dpkg"

	depends on BR2_PACKAGE_GLIBC
	depends on BR2_PACKAGE_GLIBC_UTILS

	select BR2_PACKAGE_COREUTILS
	select BR2_PACKAGE_LIBMD
	select BR2_PACKAGE_NCURSES
	select BR2_PACKAGE_TAR

	help
		Low-level package management for the Advanced Package Tool.
```
